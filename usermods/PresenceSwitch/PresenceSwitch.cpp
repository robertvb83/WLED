#include "wled.h"

/*
 * PresenceSwitch usermod
 *
 * Periodically pings a user-selected list of devices on the local network (identified by IPv4
 * address). If none of the watched devices have answered for a configurable amount of time, WLED
 * is switched off. As soon as any watched device answers again, WLED is switched back on.
 *
 * Presence checks use the ESP-IDF "ping_sock" API and are therefore ESP32-only; on ESP8266
 * the usermod compiles but presence detection is always reported as "absent".
 *
 * Devices are identified purely by IPv4 address (not MAC), so for reliable long-term tracking
 * configure a DHCP reservation for the watched devices on your router.
 */

// AI: below section was generated by an AI

#ifdef ARDUINO_ARCH_ESP32
#include "ping/ping_sock.h"
#include "lwip/ip_addr.h"
#include "lwip/ip4_addr.h"
#endif

#include <vector>
#include <algorithm>

#define PRESENCE_PING_TIMEOUT_MS 800 // max time to wait for a single ping reply
#define PRESENCE_PING_RETRIES 2      // extra attempts per watched device before declaring it absent

class PresenceSwitchUsermod : public Usermod
{
private:
    enum class Mode : uint8_t
    {
        IDLE,
        PRESENCE
    };

    // config
    bool enabled = false;
    uint16_t offDelayMin = 10;      // minutes with no watched device present before switching off (0 = never)
    uint16_t checkIntervalSec = 30; // how often watched devices are (re-)pinged

    // devices configured in extraIPs, represented as packed IPv4 keys
    std::vector<uint32_t> watchedIPs;
    std::vector<unsigned long> watchedSeenAt; // millis() a watched device last answered a presence probe
    std::vector<bool> watchedPresent;
    String extraIPs = ""; // IPv4s to always watch (comma/space/semicolon separated)

    // ping engine state machine
    Mode mode = Mode::IDLE;
    std::vector<uint32_t> queue;
    size_t queueIndex = 0;
    uint8_t presenceRetriesLeft = 0; // retries remaining for the device currently being probed (PRESENCE mode only)
    bool pingBusy = false;
    volatile bool pingGotReply = false;
    unsigned long pingStarted = 0;
#ifdef ARDUINO_ARCH_ESP32
    esp_ping_handle_t pingHandle = nullptr;
#endif

    // presence result
    bool anyPresent = false;
    unsigned long lastSeenTime = 0;
    unsigned long lastFullCheck = 0;
    bool switchedOffByMod = false;
    uint8_t restoreBri = 128;

    bool initDone = false;

    static const char _name[];
    static const char _enabled[];
    static const char _offDelay[];
    static const char _interval[];
    static const char _extraIPs[];

    static void addIpsFromString(const String &list, std::vector<uint32_t> &out);

    static uint32_t ipToKey(const IPAddress &ip)
    {
        return ((uint32_t)ip[0] << 24) | ((uint32_t)ip[1] << 16) | ((uint32_t)ip[2] << 8) | (uint32_t)ip[3];
    }
    static IPAddress keyToIp(uint32_t k)
    {
        return IPAddress((k >> 24) & 0xFF, (k >> 16) & 0xFF, (k >> 8) & 0xFF, k & 0xFF);
    }

    void startPing(const IPAddress &ip);
    void advanceQueue();
    void finishQueue();
    void beginPresenceRound();
    void applySwitch(bool on);

#ifdef ARDUINO_ARCH_ESP32
    static void onPingSuccessCb(esp_ping_handle_t hdl, void *args);
    static void onPingEndCb(esp_ping_handle_t hdl, void *args);
#endif

public:
    void setup() override
    {
        lastSeenTime = millis(); // start the "absent" timer from boot, not from an unset value
        initDone = true;
    }

    void loop() override;

    void addToJsonInfo(JsonObject &root) override
    {
        JsonObject user = root["u"];
        if (user.isNull())
            user = root.createNestedObject("u");

        JsonArray state = user.createNestedArray(FPSTR(_name));
        if (!enabled)
        {
            state.add(F("disabled"));
        }
        else
        {
            state.add(anyPresent ? F("present") : F("absent"));
            if (watchedIPs.empty())
                state.add(F(" (no devices watched)"));
        }
    }

    void addToJsonState(JsonObject &root) override
    {
        if (!initDone)
            return;
        JsonObject um = root[FPSTR(_name)];
        if (um.isNull())
            um = root.createNestedObject(FPSTR(_name));
        um["present"] = anyPresent;
    }

    void readFromJsonState(JsonObject &root) override
    {
        if (!initDone)
            return;
        JsonObject um = root[FPSTR(_name)];
        if (um.isNull())
            return;
    }

    void addToConfig(JsonObject &root) override
    {
        JsonObject top = root.createNestedObject(FPSTR(_name));
        top[FPSTR(_enabled)] = enabled;
        top[FPSTR(_offDelay)] = offDelayMin;
        top[FPSTR(_interval)] = checkIntervalSec;

        for (uint32_t k : watchedIPs)
        {
            IPAddress ip = keyToIp(k);
            char key[24];
            snprintf(key, sizeof(key), "ip_%u_%u_%u_%u", ip[0], ip[1], ip[2], ip[3]);
            top[key] = true;
        }

        top[FPSTR(_extraIPs)] = extraIPs;
    }

    bool readFromConfig(JsonObject &root) override
    {
        JsonObject top = root[FPSTR(_name)];
        bool configComplete = !top.isNull();

        configComplete &= getJsonValue(top[FPSTR(_enabled)], enabled, false);
        configComplete &= getJsonValue(top[FPSTR(_offDelay)], offDelayMin, 10);
        configComplete &= getJsonValue(top[FPSTR(_interval)], checkIntervalSec, 30);

        configComplete &= getJsonValue(top[FPSTR(_extraIPs)], extraIPs, "");
        String enteredIPs = extraIPs;
        watchedIPs.clear();
        std::vector<uint32_t> storedIPs;
        for (JsonPair kv : top)
        {
            const char *key = kv.key().c_str();
            if (strncmp(key, "ip_", 3) != 0)
                continue;
            unsigned a, b, c, d;
            if (sscanf(key + 3, "%u_%u_%u_%u", &a, &b, &c, &d) != 4)
                continue;
            uint32_t k = ipToKey(IPAddress(a, b, c, d));
            storedIPs.push_back(k);
            if (kv.value().as<bool>())
                watchedIPs.push_back(k);
        }

        std::vector<uint32_t> entered;
        addIpsFromString(enteredIPs, entered);
        for (uint32_t k : entered)
        {
            if (std::find(storedIPs.begin(), storedIPs.end(), k) == storedIPs.end())
                watchedIPs.push_back(k);
        }

        extraIPs = "";
        for (uint32_t k : watchedIPs)
        {
            if (extraIPs.length() > 0)
                extraIPs += ", ";
            extraIPs += keyToIp(k).toString();
        }
        watchedSeenAt.assign(watchedIPs.size(), 0);
        watchedPresent.assign(watchedIPs.size(), false);

        return configComplete;
    }

    void appendConfigData() override
    {
        String nm = String(FPSTR(_name));

        oappend(F("addInfo('"));
        oappend(nm.c_str());
        oappend(F(":"));
        oappend(String(FPSTR(_offDelay)).c_str());
        oappend(F("',1,'minutes with no watched device present before switching off (0 = never)');"));

        oappend(F("addInfo('"));
        oappend(nm.c_str());
        oappend(F(":"));
        oappend(String(FPSTR(_interval)).c_str());
        oappend(F("',1,'seconds between presence checks');"));

        oappend(F("addInfo('"));
        oappend(nm.c_str());
        oappend(F(":"));
        oappend(String(FPSTR(_extraIPs)).c_str());
        oappend(F("',1,'comma- or space-separated IPv4 addresses to always watch, e.g. 192.168.1.50, 192.168.1.77');"));

        for (uint32_t k : watchedIPs)
        {
            IPAddress ip = keyToIp(k);
            char key[24];
            snprintf(key, sizeof(key), "ip_%u_%u_%u_%u", ip[0], ip[1], ip[2], ip[3]);
            oappend(F("addInfo('"));
            oappend(nm.c_str());
            oappend(F(":"));
            oappend(key);
            oappend(F("',1,'"));
            size_t watchedIndex = std::find(watchedIPs.begin(), watchedIPs.end(), k) - watchedIPs.begin();
            oappend(watchedPresent[watchedIndex] ? F("present');") : F("not responding');"));
        }
    }

    uint16_t getId() override { return USERMOD_ID_PRESENCE_SWITCH; }
};

const char PresenceSwitchUsermod::_name[] PROGMEM = "PresenceSwitch";
const char PresenceSwitchUsermod::_enabled[] PROGMEM = "enabled";
const char PresenceSwitchUsermod::_offDelay[] PROGMEM = "offDelayMin";
const char PresenceSwitchUsermod::_interval[] PROGMEM = "checkIntervalSec";
const char PresenceSwitchUsermod::_extraIPs[] PROGMEM = "extraIPs";

void PresenceSwitchUsermod::addIpsFromString(const String &list, std::vector<uint32_t> &out)
{
    int start = 0;
    while (start < (int)list.length())
    {
        while (start < (int)list.length() && (list[start] == ',' || list[start] == ' ' || list[start] == ';'))
            start++;
        int end = start;
        while (end < (int)list.length() && list[end] != ',' && list[end] != ' ' && list[end] != ';')
            end++;
        if (end > start)
        {
            IPAddress ip;
            if (ip.fromString(list.substring(start, end)))
            {
                uint32_t k = ipToKey(ip);
                if (std::find(out.begin(), out.end(), k) == out.end())
                    out.push_back(k);
            }
        }
        start = end;
    }
}

void PresenceSwitchUsermod::applySwitch(bool on)
{
    if (on)
    {
        if (!switchedOffByMod)
            return; // only turn back on if we were the ones who turned it off
        bri = restoreBri;
        switchedOffByMod = false;
        // only reset segments actually running Scrolling Text (stuck font cache after a long off period);
        // a full strip.restartRuntime() would also reset unrelated segments (e.g. an active playlist preset)
        for (size_t s = 0; s < strip.getSegmentsNum(); s++) {
            Segment &seg = strip.getSegment(s);
            if (seg.mode == FX_MODE_2DSCROLLTEXT) seg.markForReset();
        }
    }
    else
    {
        if (bri == 0)
            return;
        restoreBri = bri;
        bri = 0;
        switchedOffByMod = true;
    }
    stateUpdated(CALL_MODE_BUTTON);
}

#ifdef ARDUINO_ARCH_ESP32
void PresenceSwitchUsermod::onPingSuccessCb(esp_ping_handle_t hdl, void *args)
{
    PresenceSwitchUsermod *self = (PresenceSwitchUsermod *)args;
    self->pingGotReply = true;
}

void PresenceSwitchUsermod::onPingEndCb(esp_ping_handle_t hdl, void *args)
{
    PresenceSwitchUsermod *self = (PresenceSwitchUsermod *)args;
    self->pingBusy = false;
}
#endif

void PresenceSwitchUsermod::startPing(const IPAddress &ip)
{
    pingGotReply = false;
    pingStarted = millis();
#ifdef ARDUINO_ARCH_ESP32
    if (pingHandle)
    {
        esp_ping_delete_session(pingHandle);
        pingHandle = nullptr;
    }

    ip_addr_t target;
    memset(&target, 0, sizeof(target));
    IP4_ADDR(ip_2_ip4(&target), ip[0], ip[1], ip[2], ip[3]);
    target.type = IPADDR_TYPE_V4;

    esp_ping_config_t config = ESP_PING_DEFAULT_CONFIG();
    config.target_addr = target;
    config.count = 1;
    config.timeout_ms = PRESENCE_PING_TIMEOUT_MS;
    config.interval_ms = 0;

    esp_ping_callbacks_t cbs = {};
    cbs.cb_args = this;
    cbs.on_ping_success = onPingSuccessCb;
    cbs.on_ping_timeout = nullptr;
    cbs.on_ping_end = onPingEndCb;

    pingBusy = (esp_ping_new_session(&config, &cbs, &pingHandle) == ESP_OK);
    if (pingBusy)
        esp_ping_start(pingHandle);
#else
    (void)ip;
    pingBusy = false; // ESP8266: ping engine not implemented, always reports "not found"
#endif
}

void PresenceSwitchUsermod::finishQueue()
{
    mode = Mode::IDLE;
    queue.clear();
#ifdef ARDUINO_ARCH_ESP32
    if (pingHandle)
    {
        esp_ping_delete_session(pingHandle);
        pingHandle = nullptr;
    }
#endif
}

void PresenceSwitchUsermod::advanceQueue()
{
    bool success = pingGotReply;

    if (mode == Mode::PRESENCE)
    {
        size_t watchedIndex = queueIndex;
        if (success)
        {
            watchedPresent[watchedIndex] = true;
            watchedSeenAt[watchedIndex] = millis();
            anyPresent = true;
            lastSeenTime = millis();
        }
        else if (presenceRetriesLeft > 0)
        {
            // phones/tablets in power-save mode can be slow to answer; retry before giving up on this device
            presenceRetriesLeft--;
            startPing(keyToIp(queue[queueIndex]));
            return;
        }
        else
        {
            watchedPresent[watchedIndex] = false;
        }
    }

    queueIndex++;
    if (queueIndex >= queue.size())
    {
        finishQueue();
        return;
    }
    presenceRetriesLeft = PRESENCE_PING_RETRIES;
    startPing(keyToIp(queue[queueIndex]));
}

void PresenceSwitchUsermod::beginPresenceRound()
{
    if (mode != Mode::IDLE || !WLED_CONNECTED)
        return;
    if (watchedIPs.empty())
    {
        anyPresent = false;
        return;
    }

    queue = watchedIPs;
    queueIndex = 0;
    anyPresent = false;
    presenceRetriesLeft = PRESENCE_PING_RETRIES;
    mode = Mode::PRESENCE;
    startPing(keyToIp(queue[0]));
}

void PresenceSwitchUsermod::loop()
{
    if (!initDone || !enabled)
        return;
    unsigned long now = millis();

    if (mode != Mode::IDLE)
    {
        if (pingBusy)
        {
            // safety net in case the underlying callback never fires
            if (now - pingStarted > (unsigned long)PRESENCE_PING_TIMEOUT_MS + 500)
            {
                pingBusy = false;
                pingGotReply = false;
            }
            else
            {
                return;
            }
        }
        advanceQueue();
    }

    if (!WLED_CONNECTED)
        return;

    if (now - lastFullCheck >= (unsigned long)checkIntervalSec * 1000UL)
    {
        lastFullCheck = now;
        beginPresenceRound();
    }

    if (offDelayMin > 0 && !watchedIPs.empty())
    {
        if (!anyPresent && (now - lastSeenTime > (unsigned long)offDelayMin * 60000UL))
        {
            applySwitch(false);
        }
        else if (anyPresent && switchedOffByMod)
        {
            applySwitch(true);
        }
    }
}

static PresenceSwitchUsermod presence_switch_usermod;
REGISTER_USERMOD(presence_switch_usermod);
// AI: end
